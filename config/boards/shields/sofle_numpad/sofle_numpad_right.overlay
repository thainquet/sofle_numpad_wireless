/*
 * Copyright (c) 2022 kien242
 *
 * SPDX-License-Identifier: MIT
 */

#include "sofle_numpad.dtsi"

&default_transform {
	col-offset = <6>;
};

&kscan0 {
	col-gpios
		= <&stm32_arduino 5 GPIO_ACTIVE_HIGH>
		, <&stm32_arduino 4 GPIO_ACTIVE_HIGH>
		, <&stm32_arduino 3 GPIO_ACTIVE_HIGH>
		, <&stm32_arduino 2 GPIO_ACTIVE_HIGH>
		, <&stm32_arduino 1 GPIO_ACTIVE_HIGH>
		, <&stm32_arduino 0 GPIO_ACTIVE_HIGH>
		;
};

&right_encoder {
	status = "okay";
};
