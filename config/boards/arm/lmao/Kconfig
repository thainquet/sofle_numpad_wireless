## config/boards/arm/lmao/Kconfig
```kconfig
# Copyright (c) 2022 kien242
# SPDX-License-Identifier: MIT

config BOARD_ENABLE_DCDC
	bool "Enable DCDC mode"
	select SOC_DCDC_NRF52X
	default y
	depends on (BOARD_LMAO_NRF52840 || BOARD_LMAO_STM32F401)
```

## config/boards/arm/lmao/Kconfig.board
```kconfig
# Copyright (c) 2022 kien242
# SPDX-License-Identifier: MIT

config BOARD_LMAO_NRF52840
	bool "Lmao nRF52840 Board"
	depends on SOC_NRF52840_QIAA

config BOARD_LMAO_STM32F401
	bool "Lmao STM32F401 Board"
	depends on SOC_STM32F401XC
```

## config/boards/shields/sofle_numpad/Kconfig.defconfig
```kconfig
if SHIELD_SOFLE_NUMPAD_LEFT

config ZMK_KEYBOARD_NAME
	default "Sofle numpad"

config ZMK_SPLIT_BLE_ROLE_CENTRAL
	default y
	
endif

if SHIELD_SOFLE_NUMPAD_NUM

config ZMK_KEYBOARD_NAME
      default "Sofle Numpad"

endif


if SHIELD_SOFLE_NUMPAD_RIGHT

config ZMK_KEYBOARD_NAME
      default "Sofle Numpad Right"

endif


if SHIELD_SOFLE_NUMPAD_NUM || SHIELD_SOFLE_NUMPAD_LEFT || SHIELD_SOFLE_NUMPAD_RIGHT

config ZMK_SPLIT
	default y

endif

if SHIELD_SOFLE_NUMPAD_LEFT || SHIELD_SOFLE_NUMPAD_RIGHT

if ZMK_DISPLAY

config I2C
	default y

config SSD1306
	default y

config SSD1306_REVERSE_MODE
	default y

endif # ZMK_DISPLAY

if LVGL

config LVGL_VDB_SIZE
	default 64

config LVGL_DPI
	default 148

config LVGL_BITS_PER_PIXEL
	default 1

choice LVGL_COLOR_DEPTH
	default LVGL_COLOR_DEPTH_1
endchoice

endif # LVGL

endif
```

## config/boards/shields/sofle_numpad/Kconfig.shield
```kconfig
# Copyright (c) 2022 kien242
# SPDX-License-Identifier: MIT

config SHIELD_SOFLE_NUMPAD_LEFT
	def_bool $(shields_list_contains,sofle_numpad_left)

config SHIELD_SOFLE_NUMPAD_RIGHT
	def_bool $(shields_list_contains,sofle_numpad_right)
```

## config/west.yml
```yaml
manifest:
  remotes:
    - name: zmkfirmware
      url-base: https://github.com/zmkfirmware
    - name: bezmi
      url-base: https://github.com/bezmi
    - name: slicemk
      url-base: https://github.com/slicemk
  projects:
    - name: zmk
      remote: slicemk
      revision: dongle-pr
      import: app/west.yml
  self:
    path: config
```
